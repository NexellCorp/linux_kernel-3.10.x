## drivers/platform/nexell/s5p6818/Kconfig
```kconfig
#
# Copyright 2009 Nexell.
#
menu "SLsiAP s5p6818"

choice
	prompt "Prototype build mode"
	default S5P6818_PROTO_RELEASE

	config S5P6818_PROTO_RELEASE
		bool "Release"

	config S5P6818_PROTO_DEBUG
		bool "Debug"
endchoice

config ARCH_S5P6818_BD
	bool "s5p6818 board feactures"
	default n
	depends on ARCH_S5P6818

choice
    prompt "Type"
    default ARCH_S5P6818_BD_SVT
    depends on ARCH_S5P6818_BD

   	config ARCH_S5P6818_BD_SVT
		bool "SVT: Android SVT board"
		help
   	 		Support for the SVT board.

endchoice
endmenu
```
